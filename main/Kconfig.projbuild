## main/Kconfig.projbuild
```kconfig
menu "Home Controller"

    config HOME_WIFI_SSID
        string "WiFi SSID"
        default "my-network"
        help
            Name of the WiFi network the panel joins.

    config HOME_WIFI_PASSWORD
        string "WiFi password"
        default ""
        help
            WPA2 password. Leave empty for an open network.

    config HOME_WEATHER_LAT
        string "Weather latitude"
        default "52.2297"

    config HOME_WEATHER_LON
        string "Weather longitude"
        default "21.0122"

    config HOME_WEATHER_CITY
        string "Weather location label"
        default "Warsaw"
        help
            Shown under the temperature. Purely cosmetic.

    config HOME_HA_HOST
        string "Home Assistant host"
        default "192.168.1.50:8123"
        help
            Host and port of the Home Assistant instance, without a scheme. Reached over
            plain http on the LAN.

    config HOME_HA_TOKEN
        string "Home Assistant long-lived access token"
        default ""
        help
            Created under Profile - Security - Long-lived access tokens. It is baked into
            the firmware image and stored in sdkconfig, so issue it to a dedicated HA user
            that can be revoked on its own.

    config HOME_SCREENSAVER_IDLE_S
        int "Seconds of inactivity before the ambient clock appears"
        default 60
        help
            0 disables the screensaver entirely.

    config HOME_SCREENSAVER_OFF_S
        int "Seconds of inactivity before the backlight goes out"
        default 300
        help
            Must be larger than the ambient timeout. 0 keeps the backlight on for good.

endmenu
```
